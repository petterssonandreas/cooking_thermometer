## CMakeLists.txt
```
# SPDX-License-Identifier: Apache-2.0

cmake_minimum_required(VERSION 3.20.0)
find_package(Zephyr REQUIRED HINTS $ENV{ZEPHYR_BASE})
project(ct)

target_sources(app PRIVATE
    src/adc.c
    src/alarm.c
    src/battery.c
    src/buttons.c
    src/cttime.c
    src/display.c
    src/main.c
    src/state.c
)
zephyr_include_directories(src)
```

## Kconfig
```
menu "Cooking Thermometer configuration"

module = CT_MAIN
module-str = CT-Main
source "subsys/logging/Kconfig.template.log_config"

module = CT_BUTTONS
module-str = CT-Buttons
source "subsys/logging/Kconfig.template.log_config"

module = CT_DISPLAY
module-str = CT-Display
source "subsys/logging/Kconfig.template.log_config"

module = CT_TIME
module-str = CT-Time
source "subsys/logging/Kconfig.template.log_config"

module = CT_ADC
module-str = CT-ADC
source "subsys/logging/Kconfig.template.log_config"

module = CT_STATE
module-str = CT-State
source "subsys/logging/Kconfig.template.log_config"

module = CT_BATTERY
module-str = CT-Battery
source "subsys/logging/Kconfig.template.log_config"

module = CT_ALARM
module-str = CT-Alarm
source "subsys/logging/Kconfig.template.log_config"

endmenu

source "Kconfig.zephyr"
```

## prj.conf
```kconfig
# Basic
CONFIG_GPIO=y
CONFIG_PWM=y

# Shell
CONFIG_PRINTK=y
CONFIG_SHELL=y
CONFIG_LOG_CMDS=y
CONFIG_INIT_STACKS=y
CONFIG_THREAD_STACK_INFO=y
CONFIG_KERNEL_SHELL=y
CONFIG_THREAD_MONITOR=y
CONFIG_BOOT_BANNER=y
CONFIG_THREAD_NAME=y
CONFIG_DEVICE_SHELL=y
CONFIG_THREAD_RUNTIME_STATS=y
CONFIG_THREAD_RUNTIME_STATS_USE_TIMING_FUNCTIONS=y
CONFIG_STATS=y
CONFIG_STATS_SHELL=y

# Logs
CONFIG_LOG=y
CONFIG_LOG_MODE_DEFERRED=y
# CONFIG_LOG_MODE_IMMEDIATE=y
# CONFIG_LOG_RUNTIME_FILTERING=y
CONFIG_LOG_BUFFER_SIZE=2048
CONFIG_LOG_PRINTK=y
CONFIG_LOG_PROCESS_TRIGGER_THRESHOLD=1
CONFIG_COVERAGE=n
CONFIG_LOG_TAG_MAX_LEN=8

# I2C
CONFIG_I2C=y
CONFIG_I2C_SHELL=y

# Display
CONFIG_DISPLAY=y
CONFIG_SSD1306=y
CONFIG_DISPLAY_LOG_LEVEL_INF=y
CONFIG_CHARACTER_FRAMEBUFFER=y
# Required for framebuffer
CONFIG_HEAP_MEM_POOL_SIZE=16384

# RTC
CONFIG_RTC=y
CONFIG_CLOCK_CONTROL=y
CONFIG_RTC_SHELL=y

# ADC
CONFIG_ADC=y
CONFIG_ADC_STM32=y
CONFIG_ADC_SHELL=y

# Asserts
CONFIG_ASSERT=y
```

## src/main.c
```c
/*
 * Copyright (c) 2016 Open-RnD Sp. z o.o.
 * Copyright (c) 2020 Nordic Semiconductor ASA
 *
 * SPDX-License-Identifier: Apache-2.0
 */

#include "alarm.h"
#include "battery.h"
#include "state.h"
#include <zephyr/kernel.h>
#include <zephyr/device.h>
#include <zephyr/drivers/gpio.h>
#include <zephyr/drivers/pwm.h>
#include <zephyr/sys/util.h>
#include <zephyr/sys/printk.h>

#include <zephyr/logging/log.h>
LOG_MODULE_REGISTER(ct_main, CONFIG_CT_MAIN_LOG_LEVEL);

#include "adc.h"
#include "buttons.h"
#include "display.h"
#include "cttime.h"

static void set_target_temp_timer_expiry_function(struct k_timer *timer_id) {
    state_queue_entry_t queue_entry;
    queue_entry.event = STATE_EVENT_SET_TARGET_TEMP_TIMER_ELAPSED;
    if (k_msgq_put(&state_msgq, &queue_entry, K_NO_WAIT)) {
        LOG_WRN("Failed to put target temp timer event in msgq");
    }
}

K_TIMER_DEFINE(set_target_temp_timer, set_target_temp_timer_expiry_function, NULL);

static void check_inputs(void)
{
    state_queue_entry_t queue_entry;

    switch (state.state) {
    case STATE_IDLE:
        if (state.probe_connected && (state.temperature >= state.target_temperature)) {
            queue_entry.event = STATE_EVENT_TARGET_TEMP_REACHED;
            if (k_msgq_put(&state_msgq, &queue_entry, K_NO_WAIT)) {
                LOG_WRN("Failed to put target temp reached event in msgq");
            }
        }
        break;

    case STATE_TARGET_TEMP_REACHED:
    case STATE_TARGET_TEMP_REACHED_ACKED:
        if (!state.probe_connected || (state.temperature < state.target_temperature)) {
            queue_entry.event = STATE_EVENT_TARGET_TEMP_LOST;
            if (k_msgq_put(&state_msgq, &queue_entry, K_NO_WAIT)) {
                LOG_WRN("Failed to put target temp lost event in msgq");
            }
        }
        break;

    default:
        break;
    }
}

static void state_loop(void)
{
    int ret;
    state_queue_entry_t queue_entry;

    ret = k_msgq_get(&state_msgq, &queue_entry, K_MSEC(20));
    if (ret) {
        return;
    }

    switch (state.state) {
    case STATE_IDLE:
        switch (queue_entry.event) {
        case STATE_EVENT_BUTTON_PRESSED:
            if (queue_entry.data == 2) {
                state.state = STATE_SET_TARGET_TEMP;
                state_reset_blink_timer();
                k_timer_start(&set_target_temp_timer, K_SECONDS(5), K_NO_WAIT);
            }
            break;

        case STATE_EVENT_TARGET_TEMP_REACHED:
            state.state = STATE_TARGET_TEMP_REACHED;
            alarm_enable();
            break;

        default:
            break;
        }
        break;

    case STATE_TARGET_TEMP_REACHED:
        switch (queue_entry.event) {
        case STATE_EVENT_BUTTON_PRESSED:
            /* Allow any button to ack */
            state.state = STATE_TARGET_TEMP_REACHED_ACKED;
            alarm_disable();
            break;

        case STATE_EVENT_TARGET_TEMP_LOST:
            state.state = STATE_IDLE;
            alarm_disable();
            break;

        default:
            break;
        }
        break;

    case STATE_TARGET_TEMP_REACHED_ACKED:
        switch (queue_entry.event) {
        case STATE_EVENT_TARGET_TEMP_LOST:
            state.state = STATE_IDLE;
            alarm_disable();
            break;

        case STATE_EVENT_BUTTON_PRESSED:
            if (queue_entry.data == 2) {
                state.state = STATE_SET_TARGET_TEMP;
                state_reset_blink_timer();
                k_timer_start(&set_target_temp_timer, K_SECONDS(5), K_NO_WAIT);
            }
            break;

        default:
            break;
        }
        break;

    case STATE_SET_TARGET_TEMP:
        switch (queue_entry.event) {
        case STATE_EVENT_BUTTON_PRESSED:
            if (queue_entry.data == 0) {
                state.target_temperature++;
                state_reset_blink_timer();
                k_timer_start(&set_target_temp_timer, K_SECONDS(5), K_NO_WAIT);
            }
            else if (queue_entry.data == 1) {
                state.target_temperature--;
                state_reset_blink_timer();
                k_timer_start(&set_target_temp_timer, K_SECONDS(5), K_NO_WAIT);
            }
            else if (queue_entry.data == 2) {
                state.state = STATE_IDLE;
                k_timer_stop(&set_target_temp_timer);
            }
            break;

        case STATE_EVENT_SET_TARGET_TEMP_TIMER_ELAPSED:
            state.state = STATE_IDLE;
            break;

        default:
            break;
        }
        break;

    default:
        __ASSERT(false, "Bad state: %d", state.state);
        break;
    }
}

int main(void)
{
    int ret;

    LOG_INF("main starting");

    ret = state_init();
    if (ret) {
        LOG_ERR("Error %d: failed to init state", ret);
        return ret;
    }
    LOG_INF("state init done");

    ret = alarm_init();
    if (ret) {
        LOG_ERR("Error %d: failed to init alarm", ret);
        return ret;
    }
    LOG_INF("alarm init done");

    ret = buttons_init();
    if (ret != 0) {
        LOG_ERR("Error %d: failed to init buttons", ret);
        return ret;
    }
    LOG_INF("buttons init done");

    ret = cttime_init();
    if (ret) {
        LOG_ERR("Error %d: failed to init time", ret);
        return ret;
    }
    LOG_INF("Time init done");

    ret = adc_init();
    if (ret) {
        LOG_ERR("Error %d: failed to init ADC", ret);
        return ret;
    }
    LOG_INF("ADC init done");

    ret = battery_init();
    if (ret) {
        LOG_ERR("Error %d: failed to init battery", ret);
        return ret;
    }
    LOG_INF("battery init done");

    ret = display_init();
    if (ret) {
        LOG_ERR("Error %d: failed to init display", ret);
        return ret;
    }
    LOG_INF("Display init done");

    state.state = STATE_IDLE;

    while (true) {
        state_loop();
        check_inputs();
    }

    return 0;
}
```

## src/adc.c
```c
#include "adc.h"
#include "display.h"
#include "state.h"

#include <stdlib.h>
#include <zephyr/kernel.h>
#include <zephyr/device.h>
#include <zephyr/drivers/adc.h>
#include <zephyr/drivers/gpio.h>
#include <zephyr/sys/util.h>


#include <zephyr/logging/log.h>
LOG_MODULE_REGISTER(ct_adc, CONFIG_CT_ADC_LOG_LEVEL);

static const struct device *const adc1 = DEVICE_DT_GET(DT_ALIAS(adc1));

static const struct gpio_dt_spec jack = GPIO_DT_SPEC_GET_OR(DT_ALIAS(jack_connected), gpios, {0});

/* Define ADC resolution and channel */
#define ADC_RESOLUTION 12
#define ADC_BATT_CHANNEL_ID 2
#define ADC_TEMP_CHANNEL_ID 10

/* ADC sequence configuration for battery */
static struct adc_channel_cfg adc_batt_cfg = {
    .gain             = ADC_GAIN_1,
    .reference        = ADC_REF_INTERNAL,
    .acquisition_time = ADC_ACQ_TIME_MAX,
    .channel_id       = ADC_BATT_CHANNEL_ID,
    .differential     = 0,
};

/* ADC sequence configuration for temperature */
static struct adc_channel_cfg adc_temp_cfg = {
    .gain             = ADC_GAIN_1,
    .reference        = ADC_REF_INTERNAL,
    .acquisition_time = ADC_ACQ_TIME_MAX,
    .channel_id       = ADC_TEMP_CHANNEL_ID,
    .differential     = 0,
};

typedef struct CurveValue_s
{
    int16_t raw_reading;
    int16_t temperature;
} CurveValue_t;

static CurveValue_t TemperatureCurve[] =
{
    {.raw_reading=3790, .temperature=-20},
    {.raw_reading=3046, .temperature=4},
    {.raw_reading=2226, .temperature=22},
    {.raw_reading=2120, .temperature=24},
    {.raw_reading=2016, .temperature=26},
    {.raw_reading=1724, .temperature=32},
    {.raw_reading=1664, .temperature=34},
    {.raw_reading=1407, .temperature=40},
    {.raw_reading=1104, .temperature=49},
    {.raw_reading=994, .temperature=52},
    {.raw_reading=812, .temperature=58},
    {.raw_reading=782, .temperature=59},
    {.raw_reading=584, .temperature=69},
    {.raw_reading=535, .temperature=71},
    {.raw_reading=474, .temperature=75},
    {.raw_reading=394, .temperature=81},
    {.raw_reading=370, .temperature=83},
    {.raw_reading=334, .temperature=86},
    {.raw_reading=321, .temperature=88},
};


static int16_t interpolate_temperature(int16_t raw)
{
    if (raw > TemperatureCurve[0].raw_reading) {
        return INT16_MIN;
    }
    if (raw < TemperatureCurve[ARRAY_SIZE(TemperatureCurve) - 1].raw_reading) {
        return INT16_MAX;
    }

    for (size_t i = 0; i < ARRAY_SIZE(TemperatureCurve) - 1; i++)
    {
        if ((raw <= TemperatureCurve[i].raw_reading) && (raw > TemperatureCurve[i + 1].raw_reading)) {
            int32_t raw_range = abs(TemperatureCurve[i + 1].raw_reading - TemperatureCurve[i].raw_reading);
            int32_t temp_range = abs(TemperatureCurve[i + 1].temperature - TemperatureCurve[i].temperature);
            int32_t offset_into_raw = abs(raw - TemperatureCurve[i].raw_reading);
            return ((offset_into_raw * temp_range) / raw_range) + TemperatureCurve[i].temperature;
        }
    }

    /* Should not get here */
    return INT16_MIN;
}

static K_THREAD_STACK_DEFINE(adc_temperature_thread_stack, 1024);

static struct k_thread adc_temperature_thread;

static void adc_temperature_fn(void *p1, void *p2, void *p3)
{
    UNUSED(p1);
    UNUSED(p2);
    UNUSED(p3);

    int prev_jack_value = 0;
    int jack_value = 0;

    while (true) {
        k_sleep(K_MSEC(1500));

        /* Check if probe connected */
        prev_jack_value = jack_value;
        jack_value = gpio_pin_get_dt(&jack);
        if (jack_value && !prev_jack_value) {
            LOG_INF("Jack connected!");
        }
        else if (!jack_value && prev_jack_value) {
            LOG_INF("Jack disconnected!");
        }

        if (jack_value && prev_jack_value) {
            /* Probe is connected and has been for long enough to get stable reading */
            state.probe_connected = true;

            int16_t temperature;
            int ret = adc_get_temperature(&temperature);
            if (ret) {
                LOG_ERR("Failed to get temp reading");
            }
            else {
                state.temperature = temperature;
            }
        }
        else {
            state.probe_connected = false;
            state.temperature = INT16_MIN;
        }
    }
}

int adc_init(void)
{
    int ret;

    /* Get the ADC device */
    if (!device_is_ready(adc1)) {
        LOG_ERR("ADC device not found");
        return -ENODEV;
    }

    /* Configure the ADC channel for battery voltage */
    ret = adc_channel_setup(adc1, &adc_batt_cfg);
    if (ret < 0) {
        LOG_ERR("ADC channel setup for battery failed with error %d", ret);
        return -ENODEV;
    }

    /* Configure the ADC channel for temperature voltage */
    ret = adc_channel_setup(adc1, &adc_temp_cfg);
    if (ret < 0) {
        LOG_ERR("ADC channel setup for temperature failed with error %d", ret);
        return -ENODEV;
    }

    /* Also configure Probe GPIO, to know if it is connected */
    if (!gpio_is_ready_dt(&jack)) {
        LOG_ERR("Error: button device %s is not ready", jack.port->name);
        return -ENODEV;
    }

    ret = gpio_pin_configure_dt(&jack, GPIO_INPUT);
    if (ret != 0) {
        LOG_ERR("Error %d: failed to configure %s pin %d", ret, jack.port->name, jack.pin);
        return -EIO;
    }

    k_thread_create(
        &adc_temperature_thread,
        adc_temperature_thread_stack,
        K_THREAD_STACK_SIZEOF(adc_temperature_thread_stack),
        adc_temperature_fn,
        NULL, NULL, NULL,
        K_LOWEST_APPLICATION_THREAD_PRIO,
        0,
        K_NO_WAIT);

    return 0;
}

int adc_get_battery_voltage(int16_t *vbat_mv)
{
    int ret;
    int16_t sample_buffer;
    struct adc_sequence sequence = {
        .channels    = BIT(ADC_BATT_CHANNEL_ID),
        .buffer      = &sample_buffer,
        .buffer_size = sizeof(sample_buffer),
        .resolution  = ADC_RESOLUTION,
    };

    ret = adc_read(adc1, &sequence);
    if (ret < 0) {
        LOG_ERR("ADC read failed with error %d", ret);
        return ret;
    }

    int32_t valp = sample_buffer;
    ret = adc_raw_to_millivolts(3300, adc_batt_cfg.gain, sequence.resolution, &valp);
    if (ret < 0) {
        LOG_ERR("ADC raw to mV failed with error %d", ret);
        return ret;
    }

    valp *= 2; /* Take *2 because of voltage division */
    LOG_DBG("ADC sample value: %d mV (raw: %d)", valp, sample_buffer);
    *vbat_mv = valp;
    return 0;
}

int adc_get_temperature(int16_t *temperature)
{
    int ret;
    int16_t sample_buffer;
    struct adc_sequence sequence = {
        .channels    = BIT(ADC_TEMP_CHANNEL_ID),
        .buffer      = &sample_buffer,
        .buffer_size = sizeof(sample_buffer),
        .resolution  = ADC_RESOLUTION,
    };

    ret = adc_read(adc1, &sequence);
    if (ret < 0) {
        LOG_ERR("ADC read failed with error %d", ret);
        return ret;
    }

    int16_t interpolated_temp = interpolate_temperature(sample_buffer);
    LOG_DBG("ADC temperature sample value: %d C (raw: %d)", interpolated_temp, sample_buffer);
    *temperature = interpolated_temp;
    return 0;
}
```

## src/adc.h
```c
#pragma once

#include <stdint.h>

int adc_init(void);

int adc_get_battery_voltage(int16_t *vbat_mv);

int adc_get_temperature(int16_t *temperature);
```

## src/alarm.c
```c
#include "alarm.h"
#include "state.h"
#include <zephyr/kernel.h>
#include <zephyr/device.h>
#include <zephyr/drivers/pwm.h>
#include <zephyr/drivers/gpio.h>
#include <zephyr/sys/util.h>

#include <zephyr/logging/log.h>
LOG_MODULE_REGISTER(ct_alarm, CONFIG_CT_ALARM_LOG_LEVEL);

#define PWM_LED_PERIOD NSEC_PER_MSEC

#define ALARM_ON_TIME_MSEC 50
#define ALARM_OFF_TIME_MSEC 950

static const struct pwm_dt_spec ui_led = PWM_DT_SPEC_GET(DT_ALIAS(uiled));
static const struct gpio_dt_spec buzzer = GPIO_DT_SPEC_GET(DT_ALIAS(buzzer), gpios);

static struct k_timer alarm_timer;

static uint32_t current_ui_led_pulse = 0;

static void alarm_timer_expiry_function(struct k_timer *timer_id)
{
    k_timeout_t timeout;

    if (current_ui_led_pulse > 0) {
        pwm_set_pulse_dt(&ui_led, 0);
        current_ui_led_pulse = 0;
        timeout = K_MSEC(ALARM_OFF_TIME_MSEC);
    }
    else {
        pwm_set_pulse_dt(&ui_led, PWM_LED_PERIOD);
        current_ui_led_pulse = PWM_LED_PERIOD;
        timeout = K_MSEC(ALARM_ON_TIME_MSEC);
    }

    gpio_pin_toggle_dt(&buzzer);
    k_timer_start(&alarm_timer, timeout, K_NO_WAIT);
}

static void alarm_timer_stop_function(struct k_timer *timer_id)
{
    pwm_set_pulse_dt(&ui_led, 0);
    current_ui_led_pulse = 0;
    gpio_pin_set_dt(&buzzer, 0);
}

int alarm_init(void)
{
    int ret;

    if (!gpio_is_ready_dt(&buzzer)) {
        LOG_ERR("Error: buzzer GPIO is not ready");
        return -ENODEV;
    }
    ret = gpio_pin_configure_dt(&buzzer, GPIO_OUTPUT_INACTIVE);
    if (ret < 0) {
        LOG_ERR("Error %d: failed to configure buzzer gpio", ret);
        return ret;
    }

    if (!pwm_is_ready_dt(&ui_led)) {
        LOG_ERR("Error: PWM device %s is not ready", ui_led.dev->name);
        return -ENODEV;
    }
    ret = pwm_set_dt(&ui_led, PWM_LED_PERIOD, 0);
    if (ret < 0) {
        LOG_ERR("Error %d: failed to set pulse width", ret);
        return ret;
    }
    LOG_INF("PWM LEDs init done");


    k_timer_init(&alarm_timer, alarm_timer_expiry_function, alarm_timer_stop_function);
    /* Don't start timer here */

    return 0;
}

void alarm_enable(void)
{
    k_timer_start(&alarm_timer, K_NO_WAIT, K_NO_WAIT);
}

void alarm_disable(void)
{
    k_timer_stop(&alarm_timer);
}
```

## src/alarm.h
```c
#pragma once

int alarm_init(void);

void alarm_enable(void);

void alarm_disable(void);
```

## src/battery.c
```c
#include "battery.h"
#include "adc.h"
#include "state.h"
#include <stdlib.h>
#include <zephyr/kernel.h>
#include <zephyr/device.h>
#include <zephyr/drivers/gpio.h>
#include <zephyr/shell/shell.h>
#include <zephyr/sys/util.h>

#include <zephyr/logging/log.h>
LOG_MODULE_REGISTER(ct_battery, CONFIG_CT_BATTERY_LOG_LEVEL);

typedef struct CurveValue_s
{
    uint16_t voltage_mv;
    uint8_t percentage;
} CurveValue_t;

static CurveValue_t BatteryCurve[] =
{
    {.voltage_mv=2500, .percentage=0},
    {.voltage_mv=3450, .percentage=20},
    {.voltage_mv=3600, .percentage=40},
    {.voltage_mv=3700, .percentage=60},
    {.voltage_mv=3850, .percentage=80},
    {.voltage_mv=4200, .percentage=100},
};

static uint8_t interpolate_battery_level(uint16_t voltage_mv)
{
    if (voltage_mv < BatteryCurve[0].voltage_mv) {
        return 0;
    }
    if (voltage_mv > BatteryCurve[ARRAY_SIZE(BatteryCurve) - 1].voltage_mv) {
        return 100;
    }

    for (size_t i = 0; i < ARRAY_SIZE(BatteryCurve) - 1; i++)
    {
        if ((voltage_mv >= BatteryCurve[i].voltage_mv) && (voltage_mv < BatteryCurve[i + 1].voltage_mv)) {
            int32_t voltage_range = abs(BatteryCurve[i + 1].voltage_mv - BatteryCurve[i].voltage_mv);
            int32_t percentage_range = abs(BatteryCurve[i + 1].percentage - BatteryCurve[i].percentage);
            int32_t offset_into_voltage = abs(voltage_mv - BatteryCurve[i].voltage_mv);
            return ((offset_into_voltage * percentage_range) / voltage_range) + BatteryCurve[i].percentage;
        }
    }

    /* Should not get here */
    return 0;
}

static K_THREAD_STACK_DEFINE(battery_thread_stack, 1024);

static struct k_thread battery_thread;

static void battery_fn(void *p1, void *p2, void *p3)
{
    UNUSED(p1);
    UNUSED(p2);
    UNUSED(p3);

    int ret;
    int16_t vbat_mv;

    LOG_INF("Battery thread started");
    while (true) {
        ret = adc_get_battery_voltage(&vbat_mv);
        if (ret) {
            LOG_ERR("Failed to get battery voltage");
        }
        else {
            state.battery_percentage = interpolate_battery_level(vbat_mv);
            LOG_DBG("Battery level: %u %%", state.battery_percentage);
        }

        /* No need to check this very often */
        k_sleep(K_SECONDS(10));
    }

    return;
}

int battery_init(void)
{
    k_thread_create(
        &battery_thread,
        battery_thread_stack,
        K_THREAD_STACK_SIZEOF(battery_thread_stack),
        battery_fn,
        NULL, NULL, NULL,
        K_LOWEST_APPLICATION_THREAD_PRIO,
        0,
        K_NO_WAIT);

    return 0;
}

static int battery_cmd(const struct shell *sh, size_t argc, char **argv)
{
    UNUSED(argc);
    UNUSED(argv);

    int ret;
    int16_t vbat_mv;
    uint8_t battery_percentage;

    ret = adc_get_battery_voltage(&vbat_mv);
    if (ret) {
        shell_print(sh, "Failed to get battery voltage");
        return ret;
    }

    battery_percentage = interpolate_battery_level(vbat_mv);

    shell_print(sh, "Battery info:");
    shell_print(sh, "   Voltage:    %d mV", vbat_mv);
    shell_print(sh, "   Percentage: %u%%", battery_percentage);
    return 0;
}

SHELL_CMD_REGISTER(battery, NULL, "Battery info", battery_cmd);
```

## src/battery.h
```c
#pragma once

int battery_init(void);
```

## src/buttons.c
```c
#include "state.h"
#include <zephyr/kernel.h>
#include <zephyr/device.h>
#include <zephyr/drivers/gpio.h>
#include <zephyr/sys/util.h>
#include <zephyr/sys/printk.h>
#include <errno.h>

#include <zephyr/logging/log.h>
LOG_MODULE_REGISTER(ct_buttons, CONFIG_CT_BUTTONS_LOG_LEVEL);

#define NUM_BUTTONS (3)

static const struct gpio_dt_spec buttons[NUM_BUTTONS] = {
    GPIO_DT_SPEC_GET_OR(DT_ALIAS(swa), gpios, {0}),
    GPIO_DT_SPEC_GET_OR(DT_ALIAS(swb), gpios, {0}),
    GPIO_DT_SPEC_GET_OR(DT_ALIAS(swc), gpios, {0})
};

static K_THREAD_STACK_DEFINE(buttons_thread_stack, 1024);

static struct k_thread buttons_thread;

static int buttons_pressed[NUM_BUTTONS] = {0};

bool button_is_pressed(size_t button_index)
{
    if (button_index < 0 || button_index >= ARRAY_SIZE(buttons_pressed)) {
        return -EINVAL;
    }

    return (buttons_pressed[button_index] != 0);
}

static void buttons_fn(void *p1, void *p2, void *p3)
{
    UNUSED(p1);
    UNUSED(p2);
    UNUSED(p3);

    state_queue_entry_t queue_entry;

    static int prev_button_state[NUM_BUTTONS] = {0};
    static int button_state[NUM_BUTTONS] = {0};

    LOG_INF("Button thread started");

    while (true) {
        // memcpy(prev_button_state, button_state, sizeof(prev_button_state));

        for (size_t i = 0; i < ARRAY_SIZE(buttons); i++) {
            prev_button_state[i] = button_state[i];
            button_state[i] = gpio_pin_get_dt(&buttons[i]);

            // LOG_INF("button_state[%d] = %d", i, button_state[i]);

            if ((buttons_pressed[i] == 0) && (prev_button_state[i] == 1) && (button_state[i] == 1)) {
                // Was not pressed before, but has now been pressed long enough
                // TODO: Trigger event? Callback?
                buttons_pressed[i] = 1;
                LOG_INF("Button %d pressed", i);
                queue_entry.event = STATE_EVENT_BUTTON_PRESSED;
                queue_entry.data = i;
                if (k_msgq_put(&state_msgq, &queue_entry, K_NO_WAIT)) {
                    LOG_WRN("Failed to put pressed event in msgq");
                }
            }
            else if ((buttons_pressed[i] == 1) && (prev_button_state[i] == 0) && (button_state[i] == 0)) {
                // Was pressed before, but has now been not pressed long enough
                // TODO: Trigger event? Callback?
                buttons_pressed[i] = 0;
                LOG_INF("Button %d released", i);
                queue_entry.event = STATE_EVENT_BUTTON_RELEASED;
                queue_entry.data = i;
                if (k_msgq_put(&state_msgq, &queue_entry, K_NO_WAIT)) {
                    LOG_WRN("Failed to put released event in msgq");
                }
            }
        }

        k_sleep(K_MSEC(20));
    }

    return;
}

int buttons_init(void)
{
    int ret;

    for (size_t i = 0; i < ARRAY_SIZE(buttons); i++) {
        if (!gpio_is_ready_dt(&buttons[i])) {
            LOG_ERR("Error: button device %s is not ready", buttons[i].port->name);
            return -ENODEV;
        }

        ret = gpio_pin_configure_dt(&buttons[i], GPIO_INPUT);
        if (ret != 0) {
            LOG_ERR("Error %d: failed to configure %s pin %d", ret, buttons[i].port->name, buttons[i].pin);
            return -EIO;
        }
    }

    k_thread_create(
        &buttons_thread,
        buttons_thread_stack,
        K_THREAD_STACK_SIZEOF(buttons_thread_stack),
        buttons_fn,
        NULL, NULL, NULL,
        K_LOWEST_APPLICATION_THREAD_PRIO,
        0,
        K_NO_WAIT);

    return 0;
}
```

## src/buttons.h
```c
#pragma once

#include <stdbool.h>
#include <stddef.h>

bool button_is_pressed(size_t button_index);

int buttons_init(void);
```

## src/cttime.c
```c
#include "cttime.h"

#include <zephyr/kernel.h>
#include <zephyr/device.h>
#include <zephyr/drivers/rtc.h>
#include <zephyr/sys/util.h>


#include <zephyr/logging/log.h>
LOG_MODULE_REGISTER(ct_time, CONFIG_CT_TIME_LOG_LEVEL);

static const struct device *const rtc = DEVICE_DT_GET(DT_ALIAS(rtc));

static int set_initial_date_time(void)
{
    int ret = 0;
    struct rtc_time tm = {
        .tm_year = 2024 - 1900,
        .tm_mon = 12 - 1,
        .tm_mday = 1,
        .tm_hour = 12,
        .tm_min = 0,
        .tm_sec = 0,
    };

    ret = rtc_set_time(rtc, &tm);
    if (ret < 0) {
        LOG_ERR("Cannot write date time: %d", ret);
        return ret;
    }
    return ret;
}

int cttime_get_date_time(struct rtc_time *tm)
{
    int ret = 0;

    ret = rtc_get_time(rtc, tm);
    if (ret < 0) {
        LOG_ERR("Cannot read date time: %d", ret);
        return ret;
    }

    return ret;
}

int cttime_init(void)
{
    if (!device_is_ready(rtc)) {
        LOG_ERR("Device is not ready");
        return -ENODEV;
    }

    return set_initial_date_time();
}
```

## src/cttime.h
```c
#pragma once

#include <zephyr/drivers/rtc.h>
#include <zephyr/sys/util.h>

int cttime_init(void);

int cttime_get_date_time(struct rtc_time *tm);
```

## src/display.c
```c
#include "display.h"

#include <zephyr/kernel.h>
#include <zephyr/device.h>
#include <zephyr/display/cfb.h>
#include <zephyr/drivers/display.h>
#include <stdio.h>

#include <zephyr/logging/log.h>
LOG_MODULE_REGISTER(ct_display, CONFIG_CT_DISPLAY_LOG_LEVEL);

#include "cttime.h"
#include "state.h"

#define FONT_IDX 1

static const struct device *dev = DEVICE_DT_GET(DT_CHOSEN(zephyr_display));

static K_THREAD_STACK_DEFINE(display_thread_stack, 1024);

static struct k_thread display_thread;


static void display_draw_no_probe(void)
{
    char s[16];
    snprintf(s, sizeof(s), "---");
    cfb_print(dev, s, 0, 24);
}

static void display_draw_battery_level(uint8_t battery_percentage)
{
    cfb_invert_area(dev, 109, 0, 17, 16);
    cfb_invert_area(dev, 111, 2, 13, 12);
    cfb_invert_area(dev, 126, 5, 2, 6);

    if (battery_percentage > 20) {
        cfb_invert_area(dev, 112, 4, 3, 9);
    }
    if (battery_percentage > 60) {
        cfb_invert_area(dev, 116, 4, 3, 9);
    }
    if (battery_percentage > 80) {
        cfb_invert_area(dev, 120, 4, 3, 9);
    }
}

static void display_fn(void *p1, void *p2, void *p3)
{
    UNUSED(p1);
    UNUSED(p2);
    UNUSED(p3);

    char s[16];

    while (true) {
        k_sleep(K_MSEC(100));

        /* Start by clearing */
        cfb_framebuffer_clear(dev, false);

        snprintf(s, sizeof(s), "%d", state.state);
        cfb_print(dev, s, 0, 0);

        switch (state.state) {
        case STATE_INIT:
            cfb_print(dev, "Init", 0, 24);
            break;

        case STATE_IDLE:
        case STATE_TARGET_TEMP_REACHED:
        case STATE_TARGET_TEMP_REACHED_ACKED:
            if (!state.probe_connected) {
                display_draw_no_probe();
            }
            else {
                display_draw_temperature(state.temperature);
            }
            break;

        case STATE_SET_TARGET_TEMP:
            if (state.blink) {
                snprintf(s, sizeof(s), "% 3d *C", state.target_temperature);
                cfb_print(dev, s, 0, 24);
            }
            break;

        default:
            cfb_print(dev, "state?", 0, 24);
            break;
        }

        display_draw_battery_level(state.battery_percentage);

        /* Do the actual drawing */
        cfb_framebuffer_finalize(dev);
    }
}

int display_init(void)
{
    uint16_t x_res;
    uint16_t y_res;
    uint16_t rows;
    uint8_t ppt;
    uint8_t font_width;
    uint8_t font_height;

    if (!device_is_ready(dev)) {
        LOG_ERR("Device %s not ready", dev->name);
        return -ENODEV;
    }

    if (display_set_pixel_format(dev, PIXEL_FORMAT_MONO10) != 0) {
        if (display_set_pixel_format(dev, PIXEL_FORMAT_MONO01) != 0) {
            LOG_ERR("Failed to set required pixel format");
            return -EINVAL;
        }
    }

    LOG_INF("Initialized %s", dev->name);

    if (cfb_framebuffer_init(dev)) {
        LOG_ERR("Framebuffer initialization failed!");
        return -ENODEV;
    }

    cfb_framebuffer_clear(dev, true);

    display_blanking_off(dev);

    x_res = cfb_get_display_parameter(dev, CFB_DISPLAY_WIDTH);
    y_res = cfb_get_display_parameter(dev, CFB_DISPLAY_HEIGH);
    rows = cfb_get_display_parameter(dev, CFB_DISPLAY_ROWS);
    ppt = cfb_get_display_parameter(dev, CFB_DISPLAY_PPT);

    if (cfb_get_font_size(dev, FONT_IDX, &font_width, &font_height))
    {
        LOG_ERR("Failed to get font for index %u", FONT_IDX);
        return -EBFONT;
    }
    cfb_framebuffer_set_font(dev, FONT_IDX);
    LOG_INF("font width %d, font height %d", font_width, font_height);

    LOG_INF("x_res %d, y_res %d, ppt %d, rows %d, cols %d", x_res, y_res, ppt, rows, cfb_get_display_parameter(dev, CFB_DISPLAY_COLS));

    // cfb_framebuffer_invert(dev);

    cfb_set_kerning(dev, 0);

    cfb_framebuffer_clear(dev, false);
    cfb_print(dev, "Booting", 0, 24);
    cfb_framebuffer_finalize(dev);

    /* Start display thread */
    k_thread_create(
        &display_thread,
        display_thread_stack,
        K_THREAD_STACK_SIZEOF(display_thread_stack),
        display_fn,
        NULL, NULL, NULL,
        K_LOWEST_APPLICATION_THREAD_PRIO,
        0,
        K_NO_WAIT);

    return 0;
}

void display_draw_time(void)
{
    int ret;
    struct rtc_time tm;

    ret = cttime_get_date_time(&tm);
    if (ret) {
        LOG_ERR("Failed to get time: %d", ret);
        return;
    }

    // LOG_INF("RTC date and time: %04d-%02d-%02d %02d:%02d:%02d", tm.tm_year + 1900,
    //     tm.tm_mon + 1, tm.tm_mday, tm.tm_hour, tm.tm_min, tm.tm_sec);

    char s[16];
    snprintf(s, sizeof(s), "%02d:%02d:%02d", tm.tm_hour, tm.tm_min, tm.tm_sec);

    cfb_print(dev, s, 0, 24);
}

void display_draw_voltage(int16_t mvolt, int16_t raw)
{
    char s[16];

    snprintf(s, sizeof(s), "v: %d", mvolt);
    cfb_print(dev, s, 0, 0);
    snprintf(s, sizeof(s), "r: %d", raw);
    cfb_print(dev, s, 0, 24);
}

void display_draw_temperature(int16_t temperature)
{
    char s[16];

    if (temperature == INT16_MIN) {
        snprintf(s, sizeof(s), "-99 *C");
    }
    else if (temperature == INT16_MAX) {
        snprintf(s, sizeof(s), "999 *C");
    }
    else {
        snprintf(s, sizeof(s), "% 3d *C", temperature);
    }
    cfb_print(dev, s, 0, 24);
}
```

## src/display.h
```c
#pragma once

#include <stdint.h>

int display_init(void);

void display_draw_time(void);

void display_draw_voltage(int16_t mvolt, int16_t raw);

void display_draw_temperature(int16_t temperature);
```
